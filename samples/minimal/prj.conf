## CMakeLists.txt
```
# Copyright (c) 2026 Jotheesh Kummathi
# SPDX-License-Identifier: Apache-2.0

cmake_minimum_required(VERSION 3.20.0)

# The OTA kit is the Zephyr module two directories up. Not needed if it is in your west manifest.
list(APPEND EXTRA_ZEPHYR_MODULES ${CMAKE_CURRENT_SOURCE_DIR}/../..)

find_package(Zephyr REQUIRED HINTS $ENV{ZEPHYR_BASE})
project(ota_kit_minimal)
target_sources(app PRIVATE src/main.c)
```

## prj.conf
```kconfig
# Copyright (c) 2026 Jotheesh Kummathi
# SPDX-License-Identifier: Apache-2.0
#
# Smallest use of the OTA kit, without sysbuild and without the snippet.
# The kit needs an MCUboot style image, and selects everything else itself.
CONFIG_BOOTLOADER_MCUBOOT=y
CONFIG_OTA_KIT=y
```

## boards/native_sim_native_64.conf
```kconfig
# Copyright (c) 2026 Jotheesh Kummathi
# SPDX-License-Identifier: Apache-2.0
#
# The native_sim UART has no interrupt support, so the kit cannot use it for SMP.
CONFIG_OTA_KIT_TRANSPORT_CUSTOM=y
```

## src/main.c
```c
/*
 * Copyright (c) 2026 Jotheesh Kummathi
 * SPDX-License-Identifier: Apache-2.0
 */

/* Smallest application that uses the OTA kit: register a health check, then do your work. */
#include <zephyr/kernel.h>
#include <ota_kit/ota_kit.h>

/* Replace with a real check: a sensor answers, a link is up, a self test passes. */
static bool health_ok(void)
{
	return true;
}

int main(void)
{
	ota_kit_set_health_check(health_ok);
	printk("ota_kit minimal sample, watchdog %s\n",
	       ota_kit_watchdog_armed() ? "armed" : "not used on this board");
	return 0;
}
```
